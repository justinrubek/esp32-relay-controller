## crates/esp-test/sdkconfig.defaults
```kconfig
CONFIG_ESP_MAIN_TASK_STACK_SIZE=32768
CONFIG_FREERTOS_HZ=1000
CONFIG_FREERTOS_USE_STATS_FORMATTING_FUNCTIONS=y
CONFIG_FREERTOS_USE_TRACE_FACILITY=y
CONFIG_LWIP_MAX_SOCKETS=16
CONFIG_PTHREAD_TASK_STACK_SIZE_DEFAULT=8192
CONFIG_VFS_SUPPORT_DIR=y
CONFIG_VFS_SUPPORT_IO=y
CONFIG_VFS_SUPPORT_SELECT=y
CONFIG_VFS_SUPPORT_TERMIOS=y
```
